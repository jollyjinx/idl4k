## linux/drivers/net/ivoeth/Kconfig
```kconfig
config IVO_ETH
	tristate "Inverto 10/100/1000 Ethernet driver"
	select MII
	select PHYLIB
	select CRC32
	depends on NETDEVICES
	help
	  This is the driver for the Ethernet IPs are built around a
	  Synopsys IP Core and only tested on the STMicroelectronics
	  platforms.
```
